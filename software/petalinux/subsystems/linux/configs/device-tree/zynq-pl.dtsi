/*
 *  Copyright (C) 2011 - 2014 Xilinx
 *
 * This software is licensed under the terms of the GNU General Public
 * License version 2, as published by the Free Software Foundation, and
 * may be copied, distributed, and modified under those terms.
 *
 * This program is distributed in the hope that it will be useful,
 * but WITHOUT ANY WARRANTY; without even the implied warranty of
 * MERCHANTABILITY or FITNESS FOR A PARTICULAR PURPOSE.  See the
 * GNU General Public License for more details.
 */
/include/ "video-cap.dtsi" // For no FMC setup
// /include/ "video-cap-fmc.dtsi" // For FMC setup
/include/ "video-m2m.dtsi"
/include/ "xylon-drm.dtsi"

&amba {
	apm_1: apm@400f0000 {
		compatible = "generic-uio";
		reg = <0x400f0000 0x10000>;
	};
};
